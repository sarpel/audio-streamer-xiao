## sdkconfig.defaults
```kconfig
# Project-level defaults merged into sdkconfig by PlatformIO/ESP-IDF
# Do NOT edit generated sdkconfig directly; adjust values here instead.

# HTTP server handler slots must be set in code (no Kconfig key in ESP-IDF 5.5);
# see web_server.cpp where config.max_uri_handlers is set.

# ============================================================================
# USB CONSOLE CONFIGURATION (CRITICAL for XIAO ESP32-S3)
# ============================================================================
# Use USB Serial/JTAG for reliable console output (works even if firmware crashes)
CONFIG_ESP_CONSOLE_USB_SERIAL_JTAG=y
# Disable native USB CDC (unreliable if firmware crashes early)
# CONFIG_ESP_CONSOLE_USB_CDC is not set
# Disable UART console (we're using USB)
# CONFIG_ESP_CONSOLE_UART_DEFAULT is not set
# No secondary console needed
CONFIG_ESP_CONSOLE_SECONDARY_NONE=y
# Enable USB Serial/JTAG device
CONFIG_USJ_ENABLE_USB_SERIAL_JTAG=y

# ============================================================================
# WATCHDOG CONFIGURATION
# ============================================================================
# Relax Task Watchdog timeout to avoid false positives during startup
# (You also add/reset WDT in code; this gives more headroom.)
CONFIG_ESP_TASK_WDT_TIMEOUT_S=15

# Optional: stop monitoring idle tasks to reduce noise (keep WDT for app tasks)
CONFIG_ESP_TASK_WDT_CHECK_IDLE_TASK_CPU0=n
CONFIG_ESP_TASK_WDT_CHECK_IDLE_TASK_CPU1=n

# Slightly larger TCP buffers (safe for no-PSRAM boards)
CONFIG_LWIP_TCP_SND_BUF_DEFAULT=12288   # 12 KB send buffer
CONFIG_LWIP_TCP_WND_DEFAULT=16384       # 16 KB receive window
# (Default MSS is already 1440; keep it unless you know you need to change it)

# Enable FreeRTOS runtime statistics for CPU profiling
CONFIG_FREERTOS_USE_TRACE_FACILITY=y
CONFIG_FREERTOS_GENERATE_RUN_TIME_STATS=y
CONFIG_FREERTOS_RUN_TIME_STATS_USING_ESP_TIMER=y
```
